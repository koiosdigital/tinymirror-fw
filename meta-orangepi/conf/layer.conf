## meta-orangepi/conf/layer.conf
```bitbake
# Copyright (C) 2014 NEO-Technologies
# Released under the MIT license (see COPYING.MIT for the terms)

# We have a conf and classes directory, add to BBPATH
BBPATH .= ":${LAYERDIR}"

# We have recipes-* directories, add to BBFILES
BBFILES += "${LAYERDIR}/recipes-*/*/*.bb ${LAYERDIR}/recipes-*/*/*.bbappend"

BBFILE_COLLECTIONS += "orangepi"
BBFILE_PATTERN_orangepi = "^${LAYERDIR}/"
BBFILE_PRIORITY_orangepi = "1"

# This should only be incremented on significant changes that will
# cause compatibility issues with other layers
LAYERVERSION_orangepi = "1"
LAYERSERIES_COMPAT_orangepi = "walnascar styhead"
LAYERDEPENDS_orangepi = "core meta-arm"

BBFILES_DYNAMIC += " \
    qt5-layer:${LAYERDIR}/dynamic-layers/qt5-layer/*/*/*.bb \
    qt5-layer:${LAYERDIR}/dynamic-layers/qt5-layer/*/*/*.bbappend \
"
BBFILES_DYNAMIC += " \
    rauc:${LAYERDIR}/dynamic-layers/rk-rauc-demo/*/*/*.bb \
    rauc:${LAYERDIR}/dynamic-layers/rk-rauc-demo/*/*/*.bbappend \
"
```
